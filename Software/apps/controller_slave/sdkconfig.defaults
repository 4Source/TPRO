## Software/components/apis/Kconfig
```kconfig
menu "Timeserver"

    config POLLING_INTERVAL
        int "Polling interval (ms)"
        default 10800000
        help
            The interval in ms how often the timeserver should be asked for a new time.

    config TIMEZONE
        string "Timezone"
        default "CET-1CEST,M3.5.0,M10.5.0/3"
        help
            Default corresponds to: Europe/Berlin
            The GMT0 timezone string for the timezone. 
            A list could be found here https://github.com/nayarsystems/posix_tz_db/blob/master/zones.csv

endmenu
```

## Software/components/https_server/Kconfig
```kconfig
menu "HTTPs Server configuration"

    config LISTEN_WIFI
        bool "HTTPs server should listen to the WiFi interface"
        depends on CONNECT_WIFI
        default y if CONNECT_WIFI
        help
            HTTPs server can listen to WiFi, and/or Ethernet interface for requests. 
            Choose this option to enable connection with WiFi.

    config LISTEN_ETHERNET
        bool "HTTPs server should listen to the Ethernet interface"
        depends on CONNECT_ETHERNET
        default y if CONNECT_ETHERNET
        help
            HTTPs server can listen to WiFi, and/or Ethernet interface for requests. 
            Choose this option to enable connection with Ethernet.

endmenu
```

## Software/components/https_server/Kconfig.projbuild
```kconfig
# components/https_server/Kconfig.projbuild
config ENABLE_HTTPS_SERVER
    bool "Enable HTTPS Server Component"
    default y
```

## Software/components/led/Kconfig
```kconfig
menu "LED configuration"

    # Import target specific environment variables
    orsource "$IDF_PATH/examples/common_components/env_caps/$IDF_TARGET/Kconfig.env_caps"
    
    config LED_COLUMNS
        int "Number of LEDs in a column"
        range 1 1024
        default 87

    config LED_CH1_GPIO
        int "LED GPIO number for Channel 1"
        range ENV_GPIO_RANGE_MIN ENV_GPIO_OUT_RANGE_MAX
        default 35
    
    config LED_CH1_ROWS
        int "Number of LEDs stripes connected to Channel 1"
        range 1 1024
        default 12

    config LED_CH2_GPIO
        int "LED GPIO number for Channel 2"
        range ENV_GPIO_RANGE_MIN ENV_GPIO_OUT_RANGE_MAX
        default 36
    
    config LED_CH2_ROWS
        int "Number of LEDs stripes connected to Channel 2"
        range 1 1024
        default 11

    config LED_CH3_GPIO
        int "LED GPIO number for Channel 3"
        range ENV_GPIO_RANGE_MIN ENV_GPIO_OUT_RANGE_MAX
        default 37
    
    config LED_CH3_ROWS
        int "Number of LEDs stripes connected to Channel 3"
        range 1 1024
        default 12

    config LED_STRIP_RESOLUTION_HZ 
        int "Resolution of the internal tick counter"
        default 10000000

    config LED_STRIP_T0H
        float "Duration of the T0H signal in ns"
        default 300.0

    config LED_STRIP_T0L
        float "Duration of the T0L signal in ns"
        default 900.0

    config LED_STRIP_T1H
        float "Duration of the T1H signal in ns"
        default 900.0

    config LED_STRIP_T1L
        float "Duration of the T1L signal in ns"
        default 300.0

    config LED_STRIP_RES
        float "Duration of the reset signal in ns"
        default 280000.0

endmenu
```

## Software/components/light_effect_manager/Kconfig.projbuild
```kconfig
config ENABLE_LIGHT_EFFECT_MANAGER
    bool "Enable Light Effect Manager"
    default y
```

## Software/components/network/Kconfig
```kconfig
menu "Network configuration"

    # Import target specific environment variables
    orsource "$IDF_PATH/examples/common_components/env_caps/$IDF_TARGET/Kconfig.env_caps"

    config CONNECT_WIFI
        bool "connect using WiFi interface"
        depends on (SOC_WIFI_SUPPORTED || ESP_WIFI_REMOTE_ENABLED || ESP_HOST_WIFI_ENABLED)
        default y if SOC_WIFI_SUPPORTED
        help
            Protocol examples can use WiFi, Ethernet and/or Thread to connect to the network.
            Choose this option to connect with WiFi

    if CONNECT_WIFI
        config WIFI_SSID
            string "WiFi SSID"
            default "myssid"
            help
                SSID (network name) for the example to connect to.

        config WIFI_PASSWORD
            string "WiFi Password"
            default "mypassword"
            help
                WiFi password (WPA or WPA2) for the example to use.
                Can be left blank if the network has no security set.

        config WIFI_CONN_MAX_RETRY
            int "Maximum retry"
            default 6
            help
                Set the Maximum retry to avoid station reconnecting to the AP unlimited,
                in case the AP is really inexistent.
                Set to -1 for infinite retries.
    endif

    config CONNECT_ETHERNET
        bool "connect using Ethernet interface"
        default y if !CONNECT_WIFI
        select ETH_ENABLED
        select ETH_USE_SPI_ETHERNET
        help
            Protocol examples can use WiFi, Ethernet and/or Thread to connect to the network.
            Choose this option to enable connection with Ethernet.
            Go to `Top -> Ethernet Configuration` to configure the Ethernet interface.

    if CONNECT_ETHERNET
        config ETHERNET_SPI_MISO_GPIO
            int "Ethernet SPI MISO GPIO number"
            range ENV_GPIO_RANGE_MIN ENV_GPIO_OUT_RANGE_MAX
            default 12

        config ETHERNET_SPI_MOSI_GPIO
            int "Ethernet SPI MOSI GPIO number"
            range ENV_GPIO_RANGE_MIN ENV_GPIO_OUT_RANGE_MAX
            default 11

        config ETHERNET_SPI_SCLK_GPIO
            int "Ethernet SPI SCLK GPIO number"
            range ENV_GPIO_RANGE_MIN ENV_GPIO_OUT_RANGE_MAX
            default 13

        config ETHERNET_SPI_CS_GPIO
            int "Ethernet SPI CS GPIO number"
            range ENV_GPIO_RANGE_MIN ENV_GPIO_OUT_RANGE_MAX
            default 14

        config ETHERNET_SPI_HOST
            int "Ethernet SPI Host"
            range 1 3
            default 2

        config ETHERNET_RST_GPIO
            int "Ethernet reset GPIO number"
            range ENV_GPIO_RANGE_MIN ENV_GPIO_OUT_RANGE_MAX
            default 9

        config ETHERNET_INT_GPIO
            int "Ethernet interrupt GPIO number"
            range ENV_GPIO_RANGE_MIN ENV_GPIO_OUT_RANGE_MAX
            default 10

    endif

endmenu
```

## Software/components/webserver/Kconfig
```kconfig
menu "Webserver configuration"

    config LISTEN_WIFI
        bool "webserver should listen to the WiFi interface"
        depends on CONNECT_WIFI
        default y if CONNECT_WIFI
        help
            Webserver can listen to WiFi, and/or Ethernet interface for requests. 
            Choose this option to enable connection with WiFi.

    config LISTEN_ETHERNET
        bool "webserver should listen to the Ethernet interface"
        depends on CONNECT_ETHERNET
        default y if CONNECT_ETHERNET
        help
            Webserver can listen to WiFi, and/or Ethernet interface for requests. 
            Choose this option to enable connection with Ethernet.

endmenu
```
